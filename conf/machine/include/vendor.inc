## conf/machine/include/vendor.inc
```bitbake
# To support layered ipk generation
RDK_ARTIFACTS_BASE_URL = "https://partners.artifactory.comcast.com/artifactory"
RDK_ARTIFACTS_URL = "partners.artifactory.comcast.com/artifactory"

VENDOR_EXTENSION = "-vendor"

VENDOR_REL_SDK_VERSION ??= "9.5.0"
VENDOR_IPK_REL_VERSION = "${VENDOR_REL_SDK_VERSION}"
SDKVERSION = "${VENDOR_IPK_REL_VERSION}"
VENDOR_IPK_TYPE ??= "rel"
MACHINE_COMMON_IPK = "xione-rtk-common"
VENDOR_COMMON_IPK_RELEASE ="rtk-xione-common-release"
VENDOR_COMMON_LAYER_EXTENSION = "${MACHINE_COMMON_IPK}-vendor"
PACKAGE_EXTRA_ARCHS:append = " ${VENDOR_COMMON_LAYER_EXTENSION}"
OPKG_ARCH_PRIORITY:${VENDOR_COMMON_LAYER_EXTENSION} = "300"
VENDOR_COMMON_IPK_SERVER_PATH = "${RDK_ARTIFACTS_BASE_URL}/${MACHINE}-${VENDOR_IPK_TYPE}/${VENDOR_IPK_REL_VERSION}/${MACHINE}/${VENDOR_COMMON_LAYER_EXTENSION}/ipks/${BUILD_VARIANT}"
IPK_FEED_URIS += " ${VENDOR_COMMON_LAYER_EXTENSION}##${VENDOR_COMMON_IPK_SERVER_PATH} "

VENDOR_LAYER_EXTENSION = "${MACHINE}${VENDOR_EXTENSION}"
PACKAGE_EXTRA_ARCHS:append = " ${VENDOR_LAYER_EXTENSION}"
OPKG_ARCH_PRIORITY:${VENDOR_LAYER_EXTENSION} = "305"
VENDOR_IPK_SERVER_PATH = "${RDK_ARTIFACTS_BASE_URL}/${MACHINE}-${VENDOR_IPK_TYPE}/${VENDOR_IPK_REL_VERSION}/${MACHINE}/ipks/${BUILD_VARIANT}"
IPK_FEED_URIS += " ${VENDOR_LAYER_EXTENSION}##${VENDOR_IPK_SERVER_PATH} "

VENDOR_OSS_REL_VER = "4.12.0"
VENDOR_OSS = "${@get_oss_arch(d)}${VENDOR_EXTENSION}"
PACKAGE_EXTRA_ARCHS:append = "${@ '' if '${VENDOR_OSS}' == '${OSS_LAYER_ARCH}' else ' ${VENDOR_OSS}'}"
OPKG_ARCH_PRIORITY:${VENDOR_OSS} = "310"
OSS_MACHINE = "${@get_oss_machine(d)}"
VENDOR_OSS_IPK_SERVER_PATH = "${RDK_ARTIFACTS_BASE_URL}/${MACHINE}-${VENDOR_IPK_TYPE}/${VENDOR_IPK_REL_VERSION}/${MACHINE}/rdk-arm7ve-oss-vendor/ipks/${BUILD_VARIANT}"
IPK_FEED_URIS += " ${VENDOR_OSS}##${VENDOR_OSS_IPK_SERVER_PATH} "

# This will be included only in vendor dev projects
include conf/machine/include/vendor-dev.inc
```
