## conf/layer.conf
```bitbake
#We have a conf and classes directory, add to BBPATH
BBPATH .= ":${LAYERDIR}"

# We have recipes-* directories, add to BBFILES
BBFILES += "${LAYERDIR}/recipes-*/*/*.bb \
            ${LAYERDIR}/recipes-*/*/*.bbappend \
            ${LAYERDIR}/recipes-*/*/*/*.bb \
            ${LAYERDIR}/recipes-*/*/*/*.bbappend"

BBFILE_COLLECTIONS += "middleware-generic-support"
BBFILE_PATTERN_middleware-generic-support = "^${LAYERDIR}/"
BBFILE_PRIORITY_middleware-generic-support = "13"

LAYERDEPENDS_middleware-generic-support = "core"
LAYERSERIES_COMPAT_middleware-generic-support = "dunfell kirkstone"

require include/generic-srcrev.inc
require include/generic-pkgrev.inc
require include/generic-middleware.inc
require include/mw-oss-override.inc
```
